## prj.conf
```kconfig
# nothing here

CONFIG_ZCBOR=y
```

## src/main.cpp
```c
/*
 * Copyright (c) 2012-2014 Wind River Systems, Inc.
 *
 * SPDX-License-Identifier: Apache-2.0
 */

#include <zephyr/kernel.h>
#include "zcbor_union_test.h"

int main(void)
{
    printk("Hello World! %s\n", CONFIG_BOARD);
    return 0;
}
```

## src/zcbor_union_test.c
```c
/*
 * Generated using zcbor version 0.6.99
 * https://github.com/NordicSemiconductor/zcbor
 * Generated with a --default-max-qty of 3
 */

#include <stdint.h>
#include <stdbool.h>
#include <stddef.h>
#include <string.h>
#include "zcbor_encode.h"
#include "zcbor_union_test.h"

#if DEFAULT_MAX_QTY != 3
#error "The type file was generated with a different default_max_qty than this file"
#endif

static bool encode_Foo(zcbor_state_t *state, const struct Foo_ *input);


static bool encode_Foo(
		zcbor_state_t *state, const struct Foo_ *input)
{
	zcbor_print("%s\r\n", __func__);

	bool tmp_result = (((((*input)._Foo_choice == _Foo_int) ? ((zcbor_int32_encode(state, (&(*input)._Foo_int))))
	: (((*input)._Foo_choice == _Foo_bstr) ? ((zcbor_bstr_encode(state, (&(*input)._Foo_bstr))))
	: false))));

	if (!tmp_result)
		zcbor_trace();

	return tmp_result;
}



int cbor_encode_Foo(
		uint8_t *payload, size_t payload_len,
		const struct Foo_ *input,
		size_t *payload_len_out)
{
	zcbor_state_t states[3];

	zcbor_new_state(states, sizeof(states) / sizeof(zcbor_state_t), payload, payload_len, 1);

	bool ret = encode_Foo(states, input);

	if (ret && (payload_len_out != NULL)) {
		*payload_len_out = MIN(payload_len,
				(size_t)states[0].payload - (size_t)payload);
	}

	if (!ret) {
		int err = zcbor_pop_error(states);

		zcbor_print("Return error: %d\r\n", err);
		return (err == ZCBOR_SUCCESS) ? ZCBOR_ERR_UNKNOWN : err;
	}
	return ZCBOR_SUCCESS;
}
```

## src/zcbor_union_test.h
```c
/*
 * Generated using zcbor version 0.6.99
 * https://github.com/NordicSemiconductor/zcbor
 * Generated with a --default-max-qty of 3
 */

#ifndef ZCBOR_UNION_TEST_H__
#define ZCBOR_UNION_TEST_H__

#include <stdint.h>
#include <stdbool.h>
#include <stddef.h>
#include <string.h>
#include "zcbor_encode.h"
#include "zcbor_union_test_types.h"

#if DEFAULT_MAX_QTY != 3
#error "The type file was generated with a different default_max_qty than this file"
#endif


int cbor_encode_Foo(
		uint8_t *payload, size_t payload_len,
		const struct Foo_ *input,
		size_t *payload_len_out);


#endif /* ZCBOR_UNION_TEST_H__ */
```

## src/zcbor_union_test_types.h
```c
/*
 * Generated using zcbor version 0.6.99
 * https://github.com/NordicSemiconductor/zcbor
 * Generated with a --default-max-qty of 3
 */

#ifndef ZCBOR_UNION_TEST_TYPES_H__
#define ZCBOR_UNION_TEST_TYPES_H__

#include <stdint.h>
#include <stdbool.h>
#include <stddef.h>
#include <string.h>
#include "zcbor_encode.h"

/** Which value for --default-max-qty this file was created with.
 *
 *  The define is used in the other generated file to do a build-time
 *  compatibility check.
 *
 *  See `zcbor --help` for more information about --default-max-qty
 */
#define DEFAULT_MAX_QTY 3

struct Foo_ {
	union {
		int32_t _Foo_int;
		struct zcbor_string _Foo_bstr;
	};
	enum {
		_Foo_int,
		_Foo_bstr,
	} _Foo_choice;
};


#endif /* ZCBOR_UNION_TEST_TYPES_H__ */
```
